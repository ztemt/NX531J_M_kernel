/* Copyright (c) 2013, The Linux Foundation. All rights reserved.
 *
 * This program is free software; you can redistribute it and/or modify
 * it under the terms of the GNU General Public License version 2 and
 * only version 2 as published by the Free Software Foundation.
 *
 * This program is distributed in the hope that it will be useful,
 * but WITHOUT ANY WARRANTY; without even the implied warranty of
 * MERCHANTABILITY or FITNESS FOR A PARTICULAR PURPOSE.  See the
 * GNU General Public License for more details.
 */

/*---------------------------------------------------------------------------
 * This file is autogenerated file using gcdb parser. Please do not edit it.
 * Update input XML file to add a new entry or update variable in this file
 * VERSION = "1.0"
 *---------------------------------------------------------------------------*/
&mdss_mdp {
	jdi_dsi_sp_1080p_5p5_video: qcom,mdss_dsi_jdi_r63452_1080p_5p5_video {
		qcom,mdss-dsi-panel-name = "jdi r63452 1080p 5p5 mipi video panel";
		qcom,mdss-dsi-panel-type = "dsi_video_mode";
		qcom,mdss-dsi-panel-framerate = <60>;
		qcom,mdss-dsi-virtual-channel-id = <0>;
		qcom,mdss-dsi-stream = <0>;
		qcom,mdss-dsi-panel-width = <1080>;
		qcom,mdss-dsi-panel-height = <1920>;
		qcom,mdss-dsi-h-front-porch = <96>;
		qcom,mdss-dsi-h-back-porch = <35>;
		qcom,mdss-dsi-h-pulse-width = <10>;
		qcom,mdss-dsi-h-sync-skew = <0>;
		qcom,mdss-dsi-v-back-porch = <8>;
		qcom,mdss-dsi-v-front-porch = <8>;
		qcom,mdss-dsi-v-pulse-width = <6>;
		qcom,mdss-dsi-h-left-border = <0>;
		qcom,mdss-dsi-h-right-border = <0>;
		qcom,mdss-dsi-v-top-border = <0>;
		qcom,mdss-dsi-v-bottom-border = <0>;
		qcom,mdss-dsi-bpp = <24>;
		qcom,mdss-dsi-underflow-color = <0xff>;
		qcom,mdss-dsi-border-color = <0>;
		qcom,mdss-dsi-on-command = [
				39 01 00 00 00 00 02 B0 00
				39 01 00 00 00 00 02 D6 01
				39 01 00 00 00 00 02 35 00
				39 01 00 00 00 00 02 36 00
				39 01 00 00 00 00 02 3A 77
				39 01 00 00 00 00 05 2A 00 00 04 37 //set column address
				39 01 00 00 00 00 05 2B 00 00 07 7F //set page address
				39 01 00 00 40 00 03 44 00 00
			        39 01 00 00 00 00 02 51 FF//write CABC
				39 01 00 00 00 00 02 53 0C
				39 01 00 00 00 00 02 55 00
				39 01 00 00 80 00 02 11 00//Sleep out
			        39 01 00 00 00 00 02 B3 3D
			        39 01 00 00 00 00 02 29 00
     				];
		qcom,mdss-dsi-off-command = [
			        39 01 00 00 14 00 02 28 00
				39 01 00 00 78 00 02 10 00];
		nubia,mdss-dsi-ce-command-off = [
    		];
		nubia,mdss-dsi-ce-command-soft = [
			39 01 00 00 00 00 02 B0 00
			39 01 00 00 00 00 02 D6 01
			39 01 00 00 00 00 2C CA 1D FC FC FC 00 D1 D1 A8 00 A8 CE CE 00 9C 00 00 00 BA 00 00 00 9C FF 9F 83 FF 9F 83 7D 00 00 00 00 00 00 00 00 00 00 00 00 00 00
					];
		nubia,mdss-dsi-ce-command-std = [
			39 01 00 00 00 00 02 B0 00
			39 01 00 00 00 00 02 D6 01
			39 01 00 00 00 00 2C CA 00 FC FC FC 00 D1 D1 A8 00 A8 CE CE 00 9C 00 00 00 BA 00 00 00 9C FF 9F 83 FF 9F 83 7D 00 00 00 00 00 00 00 00 00 00 00 00 00 00
					];
		nubia,mdss-dsi-ce-command-glow = [
			39 01 00 00 00 00 02 B0 00
			39 01 00 00 00 00 02 D6 01
			39 01 00 00 00 00 2C CA 3D FC FC FC 00 D5 D5 AA 00 AA D1 D1 00 99 00 00 00 B4 00 00 00 99 FF 9F 83 FF 9F 83 7D 00 00 00 00 00 00 00 00 00 00 00 00 00 00
					];

		nubia,mdss-dsi-cabc-command-off = [
			39 01 00 00 00 00 02 55 00
		];
		nubia,mdss-dsi-ce-command-lever1 = [
			39 01 00 00 00 00 02 55 01
		];
		nubia,mdss-dsi-ce-command-lever2 = [
			39 01 00 00 00 00 02 55 02
		];
		nubia,mdss-dsi-ce-command-lever3 = [
			39 01 00 00 00 00 02 55 03
		];

		nubia,mdss-dsi-ce-cabc-command0 = [
		];
		nubia,mdss-dsi-ce-cabc-command1 = [
		];
		nubia,mdss-dsi-ce-cabc-command2 = [
		];
		nubia,mdss-dsi-ce-cabc-command3 = [
		];
		nubia,mdss-dsi-ce-cabc-command4 = [
		];
		nubia,mdss-dsi-ce-cabc-command5 = [
		];
    		nubia,mdss-dsi-ce-cabc-command6 = [
		];
    		nubia,mdss-dsi-ce-cabc-command7 = [
		];
		nubia,mdss-dsi-ce-cabc-command8 = [
		];
    		nubia,mdss-dsi-ce-cabc-command9 = [
		];
    		nubia,mdss-dsi-ce-cabc-command10 = [
		];
    		nubia,mdss-dsi-ce-cabc-command11 = [
		];
		nubia,mdss-dsi-ce-cabc-command12 = [
		];
    		nubia,mdss-dsi-ce-cabc-command13 = [
		];
    		nubia,mdss-dsi-ce-cabc-command14 = [
		];
    		nubia,mdss-dsi-ce-cabc-command15 = [
		];

		nubia,mdss-dsi-panel-backlight-curve = [
			00 01 01 01 01 01 01 01
			01 01 01 01 01 01 01 01
			01 01 01 01 02 02 02 02
			02 02 02 02 03 03 03 03
			04 04 04 04 05 05 05 05
			06 06 06 06 07 07 07 07
			08 08 08 08 09 09 09 09
			0A 0A 0A 0B 0B 0B 0C 0C
			0C 0D 0D 0D 0E 0E 0E 0F
			0F 0F 10 10 10 11 11 12
			12 13 13 14 14 15 15 16
			16 17 17 18 18 19 1A 1B
			1B 1C 1C 1D 1D 1E 1F 20
			20 20 21 21 22 23 24 25
			25 26 26 27 28 29 2A 2B
			2B 2C 2D 2E 2F 30 31 32
			32 33 34 35 36 37 38 39
			3A 3B 3C 3D 3E 3F 40 41
			42 43 44 45 46 47 48 49
			4A 4B 4C 4D 4E 4F 50 52
			53 54 55 57 58 59 5A 5C
			5D 5E 60 61 63 64 65 67
			68 69 6B 6C 6E 6F 70 72
			73 75 76 78 7A 7B 7D 7E
			80 81 83 84 86 88 89 8B
			8D 8F 90 91 93 95 97 99
			9B 9D 9F A1 A3 A5 A6 A8
			AA AC AE B0 B2 B4 B5 B7
			B9 BB BD BF C1 C3 C5 C7
			C9 CB CD CF D1 D3 D5 D8
			DB DD DF E1 E3 E5 E7 E9
			EC EF F2 F5 F7 F9 FC FF
			];
		qcom,mdss-dsi-on-command-state = "dsi_lp_mode";
		qcom,mdss-dsi-off-command-state = "dsi_hs_mode";
		nubia,mdss-dsi-ce-command-state = "dsi_lp_mode";
		nubia,mdss-dsi-cabc-command-state = "dsi_lp_mode";
		nubia,mdss-dsi-ce-cabc-command-state = "dsi_lp_mode";
		qcom,mdss-dsi-h-sync-pulse = <0>;
		qcom,mdss-dsi-traffic-mode = "non_burst_sync_event";
		qcom,mdss-dsi-bllp-eof-power-mode;
		qcom,mdss-dsi-bllp-power-mode;
		qcom,mdss-dsi-lane-0-state;
		qcom,mdss-dsi-lane-1-state;
		qcom,mdss-dsi-lane-2-state;
		qcom,mdss-dsi-lane-3-state;
		qcom,mdss-dsi-panel-timings = [e2 36 24 00 66 6a 28 38 2a 03 04 00];
		qcom,mdss-dsi-t-clk-post = <0x02>;
		qcom,mdss-dsi-t-clk-pre = <0x2a>;
		qcom,mdss-brightness-max-level = <255>;
		qcom,mdss-brightness-min-level = <2>;
		qcom,mdss-dsi-bl-min-level = <1>;
		qcom,mdss-dsi-bl-max-level = <4095>;
		mdss-dsi-hfp-power-mode;
		mdss-dsi-hsa-power-mode;
		mdss-dsi-hbp-power-mode;
		mdss-dsi-bllp-power-mode;
		mdss-dsi-bllp-eof-power-mode;
		qcom,mdss-dsi-dma-trigger = "trigger_sw";
		qcom,mdss-dsi-mdp-trigger = "none";
		qcom,mdss-dsi-bl-pmic-control-type = "bl_ctrl_wled";
		qcom,mdss-dsi-bl-pmic-control-reg  = <0x51>;
		qcom,mdss-dsi-reset-sequence = <1 12>, <0 5>, <1 12>;
		qcom,mdss-pan-physical-width-dimension = <68>;
		qcom,mdss-pan-physical-height-dimension = <121>;
		qcom,mdss-dsi-min-refresh-rate = <53>;
		qcom,mdss-dsi-max-refresh-rate = <60>;
		qcom,mdss-dsi-pan-enable-dynamic-fps;
		qcom,mdss-dsi-pan-fps-update = "dfps_immediate_porch_mode_vfp";
	};
};
