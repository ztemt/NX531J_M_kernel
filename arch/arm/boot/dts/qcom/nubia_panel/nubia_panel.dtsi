#include "nubia-dsi-panel-jdi-r63452-1080p-5p5-cmd.dtsi"
#include "nubia-dsi-panel-jdi-r63452-1080p-5p5-video.dtsi"
#include "zte-dsi-panel-sharp-r63417-1080p-5p5-cmd.dtsi"
#include "zte-dsi-panel-sharp-r63417-1080p-5p5-video.dtsi"
